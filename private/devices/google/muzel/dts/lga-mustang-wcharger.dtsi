// SPDX-License-Identifier: GPL-2.0-only
/*
 * Wireless charger device tree for Mustang
 *
 * Copyright 2024 Google LLC
 *
 */

#include "lga-muzel-wcharger.dtsi"

&google_cpm {
	google,no-init-wlc-ta-vol;
};

&google_wlc {
	google,project_id = /bits/ 8 <0x05>;
	google,has_wlc_dc = <1>;
	google,dploss_steps = <9000 12000 14750>;
	google,dploss_points = <25>;
	qi22_en-gpio = <&max77779_sgpio 2 GPIO_ACTIVE_HIGH>; /* OD3 QI22_EN */
	google,wlc-bootloader = "CPS4041_BL.bin";
	google,wlc-firmware = "CPS4041_A0_05.bin";
	wlc_dc_mdis_fcc = <4958000 4775680 4593360 4411040 4228720 4046400 3864080 3681760 3499440
			   3317120 3134800 2952480 2770160 2587840 2405520 2223200 2040880 1858560
			   1676240 1493920 1311600 1129280  946960  764640  582320  400000>;
};
