// SPDX-License-Identifier: GPL-2.0-only
/*
 * Wireless charger device tree for Frankel
 *
 * Copyright 2024 Google LLC
 *
 */

#include "lga-muzel-wcharger.dtsi"

&google_wlc {
	google,project_id = /bits/ 8 <0x02>;
	google,wlc-bootloader = "CPS4041_BL.bin";
	google,wlc-firmware = "CPS4041_A0_02.bin";

	bpp_mdis_pwr = <5000000 4900760 4801520 4702280 4603040 4503800 4404560 4305320 4206080
			4106840 4007600 3908360 3809120 3709880 3610640 3511400 3412160 3312920
			3213680 3114440 3015200 2915960 2816720 2717480 2618240 2519000>;
	mpp_mdis_pwr = <15000000 14495560 13991120 13486680 12982240 12477800 11973360 11468920
			10964480 10460040  9955600  9451160  8946720  8442280  7937840  7433400
			 6928960  6424520  5920080  5415640  4911200  4406760  3902320  3397880
			 2893440  2389000>;
	google,wlc_mod_soc = <75>;
};
