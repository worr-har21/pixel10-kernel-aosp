// SPDX-License-Identifier: GPL-2.0-only

&irm_gmc_freq {
	gmc-memss-table =
		/* gmc		memss */
		< 410000000	178000000 >,
		< 672000000	233000000 >,
		< 998400000	333000000 >,
		< 1536000000	466000000 >,
		< 1996800000	666000000 >,
		< 2688000000	711000000 >,
		< 3686400000	800000000 >,
		< 4224000000	932000000 >;
};
