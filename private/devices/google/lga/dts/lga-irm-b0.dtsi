// SPDX-License-Identifier: GPL-2.0-only

&irm_gmc_freq {
	gmc-memss-table =
		/* gmc		memss */
		<  409000000	178000000 >,
		<  537000000	178000000 >,
		<  672000000	233000000 >,
		<  844000000	233000000 >,
		<  998000000	466000000 >,
		< 1344000000	466000000 >,
		< 1536000000	666000000 >,
		< 1689000000	666000000 >,
		< 1996000000	711000000 >,
		< 2227000000	800000000 >,
		< 2688000000	800000000 >,
		< 3148000000	800000000 >,
		< 3686000000	932000000 >,
		< 4224000000	932000000 >;
};
