## private/google-modules/soc/rdo/Documentation/devicetree/bindings/dpm/google,dpm.yaml
```yaml
# SPDX-License-Identifier: (GPL-2.0-only OR BSD-2-Clause)
# Copyright 2023 Google LLC
%YAML 1.2
---
$id: http://devicetree.org/schemas/dpm/google,dpm.yaml#
$schema: http://devicetree.org/meta-schemas/core.yaml#

title: Debug Policy Module (DPM) config sources

maintainers:
  - Kanstantsin Yarmash <kyarmash@google.com>

description:
  Define different property values for user, userdebug or eng DPM image

properties:
  version:
    description: Used to manage the automatic DPM install. After each change
      to the Debug Policy sources, the value of the version field should be
      incremented and propagated to all DP variants, even if there are no
      changes to them.

  variant:
    description: Used to determine Android build type user/eng/userdebug
    - enum:
      - user
      - eng
      - userdebug

  security:
    type: object
    description: Configuration values for the TF-A firmware

  abl:
    type: object
    description: Configuration values for the ABL firmware

  feature:
    type: object
    description: Configuration values for the Crash Debug Dump (CDD) driver

required:
  - version
  - variant

additionalProperties: false

examples:
  - |
  dpm {
    version = <101>;
    variant = "user";

    security {
      sdm_enable = <0>;
      ERXPFG_enable = <0>;
    };

    abl {
      ramdump_mode = <0>;
      ramdump2usb = <0>;
    };

    feature {
      dump-mode {
        enabled = <1>;
      };
    };
  };
...
```

## private/google-modules/soc/rdo/Documentation/devicetree/bindings/i3c/snps,dw-i3c-master.yaml
```yaml
# SPDX-License-Identifier: GPL-2.0
%YAML 1.2
---
$id: http://devicetree.org/schemas/i3c/snps,dw-i3c-master.yaml#
$schema: http://devicetree.org/meta-schemas/core.yaml#

title: Synopsys DesignWare I3C master block

maintainers:
  - Alexandre Belloni <alexandre.belloni@bootlin.com>

allOf:
  - $ref: i3c.yaml#

properties:
  compatible:
    const: snps,dw-i3c-master-1.00a

  reg:
    maxItems: 1

  clocks:
    maxItems: 1

  interrupts:
    maxItems: 1

  ibi-capable:
    type: boolean
    description: Mark if the device supports In-Band Interrupt

  hybrid-busy-wait-mode:
    type: boolean
    description:
      True if desired operation (transfer execution) mode is hybrid, false if
      interrupt mode should always be used. If not present, false/ir mode is
      automatically assumed

  i2c-hybrid-threshold:
    type: u32
    maxItems: 1
    description:
      If hybrid-busy-wait-mode is true, then this threshold is used to switch
      between busy-waiting and interrupt modes; busy-waiting is used for values
      below the threshold, otherwise interrupt mode is used.
      Unit is Bytes. It is recommended to omit this property, so the default
      value is used, unless one is sure of their choice and wants to customise
      the functionality.

  i3c-hybrid-threshold:
    type: u32
    maxItems: 1
    description:
      If hybrid-busy-wait-mode is true, then this threshold is used to switch
      between busy-waiting and interrupt modes; busy-waiting is used for values
      below the threshold, otherwise interrupt mode is used
      Unit is Bytes. It is recommended to omit this property, so the default
      value is used, unless one is sure of their choice and wants to customise
      the functionality.

  external-power-control:
    type: boolean
    description: Enable external power control instead of auto runtime PM

required:
  - compatible
  - reg
  - clocks
  - interrupts

unevaluatedProperties: false

examples:
  - |
    i3c-master@2000 {
        compatible = "snps,dw-i3c-master-1.00a";
        #address-cells = <3>;
        #size-cells = <0>;
        reg = <0x02000 0x1000>;
        interrupts = <0>;
        clocks = <&i3cclk>;

        hybrid-busy-wait-mode;
        i2c-hybrid-threshold = <30>;
        i3c-hybrid-threshold = <30>;

        eeprom@57{
            compatible = "atmel,24c01";
            reg = <0x57 0x0 0x10>;
            pagesize = <0x8>;
        };
    };
...
```

## private/google-modules/soc/rdo/Documentation/devicetree/bindings/power-controller/google,power-controller.yaml
```yaml
# SPDX-License-Identifier: (GPL-2.0-only OR BSD-2-Clause) Copyright 2024 Google
# LLC
%YAML 1.2 --- $id: http://devicetree.org/schemas/pinctrl/google,pinctrl.yaml#
$schema: http://devicetree.org/meta-schemas/core.yaml#

title: Google Power controller

maintainers: - Mahesh Sivasubramanian <msivasub@google.com> - Ben Schwartz
  <bsschwar@google.com>

description: Defines the power controlller configurations for the SSWRPs in the
  SOC. This node in turn contains a number of subnodes that define the property
  of every power domain.

properties:
  compatible:
    description:
      Defines the platform/version of power controller.
    values:
      - "google,lga-power-controller" - LGA

  mboxes:
    description:
      Phandle reference to the CPM mailbox

Example:
	power_controller: power_controller {
		compatible = "google,lga-power-controller";
		mboxes = <&goog_mba_cpm_iface>;
		#address-cells = <0x00000002>;
		#size-cells = <0x00000002>;
		ranges;

		sswrp_gpu_pd: sswrp_gpu_pd {
			#power-domain-cells = <0>;
			sswrp-id = <GENPD_LGA_SSWRP_GPU_ID>;
		};

		gpu_core_logic_pd: gpu_core_logic_pd@34809400 {
			reg = <0 0x3480a000 0 0x4>,
						<0 0x34826000 0 0x400>,
						<0 0x34820a30 0 0x10>,
						<0 0x34855c40 0 0x10>;
			reg-names = "gpu_control", "pvtc", "pvtc_pwroff", "dts";
			#power-domain-cells = <0>;
			sswrp-id = <GENPD_LGA_SSWRP_GPU_ID>;
			power-domains = <&sswrp_gpu_pd>;
			subdomain-id = <GENPD_LGA_GPU_CORE_LOGIC_ID>;
		};
	};
```

## private/google-modules/soc/rdo/Documentation/devicetree/bindings/power-controller/power-domain.yaml
```yaml
# SPDX-License-Identifier: (GPL-2.0-only OR BSD-2-Clause) Copyright 2024 Google
# LLC
%YAML 1.2 --- $id:
  http://devicetree.org/schemas/pinctrl/google,power-controller.yaml# $schema:
    http://devicetree.org/meta-schemas/core.yaml#

title: Google Power domain

maintainers: - Mahesh Sivasubramanian <msivasub@google.com> - Ben Schwartz
  <bsschwar@google.com>

description:
  Defines the power domain properties to control the power of the differens
  SSWRPS in the subsystem.


properties:
  reg:
    description:
      Optional flag for turning on/off specific domains within a SSWRP. For now,
      applicable only for GPU.

  sswrp-id:
    description:
      Enum of the SSWRP thats powered down/off

  power-domains:
    description:
      For subdomains within a SSWRP, defines the parent subdomain reference. Not
      required if power domain is the top domain.

  subdomain-id:
    description:
      Unique ID for a subdomain within Parent domain. Not
      required for parent domains.

  on-at-init:
    description:
      Optional boolean flag indicating that the power domains
      needs to be turned on during init.

  rpm-always-on:
    description:
      Optional flag to disallow runtime pm suspend

  irq-safe:
    description:
      Optional flag to indicate a power domain as IRQ-safe

  always-on:
    description:
      Optional flag to disallow power down.

  use-smc:
    description:
      Make SMC service calls to initiate a power transition instead of going
      through the CPM mailbox. Some power domains could be powered on from
      interrupt handlers and the delays around CPM mailbox maynot be acceptable.
      This may be used only for power domains for which AP is the only client
      voting for it.

  no-auto-resume:
    description:
      Overwrite power domain's resume_noirq callback, so when kernel resume flow
      is triggered and a device driver is being resumed its power domain is not
      automatically turned on, which is the default linux behaviour.
```

## private/google-modules/soc/rdo/Kconfig
```kconfig
# SPDX-License-Identifier: GPL-2.0-only

menuconfig ARCH_GOOGLE
	bool "Google SoC platform"
	depends on ARM64
	help
	  Say Y here to get to see options for platform support for
	  Google SoC drivers. This option alone does not add any
	  kernel code. If you say N, all options in this submenu will
	  be skipped and disabled.

if ARCH_GOOGLE

config SOC_RDO
	bool "SOC is RDO"
	help
	  Select Y if the SOC is Redondo.
	  SOC is short for System on Chip
	  RDO is short for Redondo.
	  RDO kernel modules depend on this configuration.

config SOC_LGA
	bool "SOC is LGA"
	help
	  Select Y if the SOC is Laguna.
	  SOC is short for System on Chip
	  LGA is short for Laguna.
	  LGA kernel modules depend on this configuration.

endif # ARCH_GOOGLE

source "$(KCONFIG_SOC_RDO_PREFIX)ap-pmic/Kconfig"
source "$(KCONFIG_SOC_RDO_PREFIX)boot-diary/Kconfig"
source "$(KCONFIG_SOC_RDO_PREFIX)cap-sysfs/Kconfig"
source "$(KCONFIG_SOC_RDO_PREFIX)clk/google/Kconfig"
source "$(KCONFIG_SOC_RDO_PREFIX)clocksource/google/sst/Kconfig"
source "$(KCONFIG_SOC_RDO_PREFIX)cpm-cli/Kconfig"
source "$(KCONFIG_SOC_RDO_PREFIX)cpm-tracepoint/Kconfig"
source "$(KCONFIG_SOC_RDO_PREFIX)cpmlog/Kconfig"
source "$(KCONFIG_SOC_RDO_PREFIX)cpufreq/Kconfig"
source "$(KCONFIG_SOC_RDO_PREFIX)cs-ets/Kconfig"
source "$(KCONFIG_SOC_RDO_PREFIX)cstate-ctrl/Kconfig"
source "$(KCONFIG_SOC_RDO_PREFIX)devfreq/dsufreq/Kconfig"
source "$(KCONFIG_SOC_RDO_PREFIX)drivers/clk/google/Kconfig"
source "$(KCONFIG_SOC_RDO_PREFIX)drivers/devfreq/Kconfig"
source "$(KCONFIG_SOC_RDO_PREFIX)drivers/dma/Kconfig"
source "$(KCONFIG_SOC_RDO_PREFIX)drivers/i2c/busses/Kconfig"
source "$(KCONFIG_SOC_RDO_PREFIX)drivers/i3c/master/Kconfig"
source "$(KCONFIG_SOC_RDO_PREFIX)drivers/irqchip/Kconfig"
source "$(KCONFIG_SOC_RDO_PREFIX)drivers/mailbox/Kconfig"
source "$(KCONFIG_SOC_RDO_PREFIX)drivers/perf/Kconfig"
source "$(KCONFIG_SOC_RDO_PREFIX)drivers/pinctrl/google/Kconfig"
source "$(KCONFIG_SOC_RDO_PREFIX)drivers/power/Kconfig"
source "$(KCONFIG_SOC_RDO_PREFIX)drivers/rst/google/Kconfig"
source "$(KCONFIG_SOC_RDO_PREFIX)drivers/soc/google/Kconfig"
source "$(KCONFIG_SOC_RDO_PREFIX)drivers/spi/Kconfig"
source "$(KCONFIG_SOC_RDO_PREFIX)drivers/spmi/Kconfig"
source "$(KCONFIG_SOC_RDO_PREFIX)drivers/ufs/Kconfig"
source "$(KCONFIG_SOC_RDO_PREFIX)ebu/Kconfig"
source "$(KCONFIG_SOC_RDO_PREFIX)edac/Kconfig"
source "$(KCONFIG_SOC_RDO_PREFIX)experimental/Kconfig"
source "$(KCONFIG_SOC_RDO_PREFIX)gadget/dta/Kconfig"
source "$(KCONFIG_SOC_RDO_PREFIX)gadget/perf_test/Kconfig"
source "$(KCONFIG_SOC_RDO_PREFIX)gpca/Kconfig"
source "$(KCONFIG_SOC_RDO_PREFIX)hardlockup-debug/Kconfig"
source "$(KCONFIG_SOC_RDO_PREFIX)interconnect/Kconfig"
source "$(KCONFIG_SOC_RDO_PREFIX)ip-idle-notifier/Kconfig"
source "$(KCONFIG_SOC_RDO_PREFIX)cpu-lpm-stats/Kconfig"
source "$(KCONFIG_SOC_RDO_PREFIX)lpcm/Kconfig"
source "$(KCONFIG_SOC_RDO_PREFIX)mem-qos/Kconfig"
source "$(KCONFIG_SOC_RDO_PREFIX)odpm/Kconfig"
source "$(KCONFIG_SOC_RDO_PREFIX)pci/Kconfig"
source "$(KCONFIG_SOC_RDO_PREFIX)phy/Kconfig"
source "$(KCONFIG_SOC_RDO_PREFIX)power-controller/Kconfig"
source "$(KCONFIG_SOC_RDO_PREFIX)powerdashboard/Kconfig"
source "$(KCONFIG_SOC_RDO_PREFIX)pwm/Kconfig"
source "$(KCONFIG_SOC_RDO_PREFIX)soc/google/Kconfig"
source "$(KCONFIG_SOC_RDO_PREFIX)thermal/Kconfig"
source "$(KCONFIG_SOC_RDO_PREFIX)trace/Kconfig"
source "$(KCONFIG_SOC_RDO_PREFIX)drivers/tty/serial/8250/Kconfig"
source "$(KCONFIG_SOC_RDO_PREFIX)usb/Kconfig"
source "$(KCONFIG_SOC_RDO_PREFIX)watchdog/Kconfig"
```

## private/google-modules/soc/rdo/cpm-tracepoint/Kconfig
```kconfig
# SPDX-License-Identifier: GPL-2.0-only

config GOOGLE_CPM_TRACEPOINT
	tristate "Google CPM tracepoint driver"
	depends on ARCH_GOOGLE
	depends on GOOGLE_MBA_CPM_INTERFACE
	help
	  Enable support for Google CPM tracepoint driver.
	  The driver creates a debugfs interface to accept
	  CPM tracepoint requests from user-space.
	  The driver retrieves tracepoints from CPM and print them out
	  to the kernel log.
	  Say N if you are unsure.
```

## private/google-modules/soc/rdo/drivers/i2c/busses/Kconfig
```kconfig
# SPDX-License-Identifier: GPL-2.0-only

config I2C_DW_GOOGLE_CORE
	tristate "DW Google I2C core"
	select REGMAP

config I2C_DW_GOOGLE_QUIRKS
	tristate "DW Google I2C Platform Quirks"
	depends on ARCH_GOOGLE
	depends on I2C
	select I2C_DW_GOOGLE_CORE
	help
	  Enable the upstream I2C designware platform driver
```

## private/google-modules/soc/rdo/drivers/soc/google/debug/Kconfig
```kconfig
# SPDX-License-Identifier: GPL-2.0

config GOOGLE_PMU_EHLD
	tristate "GOOGLE PMU EHLD Kernel driver"
	help
	  Enable support for detecting hardware hang

	  This driver with the help of GDMC monitors CPU state.
	  If GDMC detects lokcup or hang, it notifies this driver
	  and the driver obtains necessary debugging information.
	  Select Y if you have such device.

	  If unsure select "N".

config GOOGLE_EHLD_COREINSTR
	tristate "Google Coreinstr EHLD Kernel driver"
	help
	  Enable support for detecting hardware hang

	  This driver with the help of GDMC monitors CPU state.
	  If GDMC detects lokcup or hang, it notifies this driver
	  and the driver obtains necessary debugging information.
	  Select Y if you have such device.

	  If unsure select "N".
```

## private/google-modules/soc/rdo/drivers/soc/google/vdu/Kconfig
```kconfig
# SPDX-License-Identifier: GPL-2.0-only

config GOOGLE_VOLATILE_DEBUG_UNLOCK
	tristate "Google Volatile Debug Unlock"
	help
	  Volatile Debug Unlock is a kernel driver that offers its
	  interface through sysfs files, and it enables interaction
	  with the VDU hardware for authentication and status queries.
	  It facilitates device information retrieval, authentication
	  flow support, and status checks, and it is used to establish
	  and manage VDU sessions.
```

## private/google-modules/soc/rdo/drivers/spi/Kconfig
```kconfig
# SPDX-License-Identifier: GPL-2.0-only

config SPI_DW_GOOGLE_QUIRKS
	tristate "Support for Synopsys DesignWare DW_apb_ssi quirks"
	depends on SPI_DESIGNWARE
	help
	  Enable support for the SPI controller
	  on Google devices.
	  Select Y if you have such device.
	  If unsure select "N".
```

## private/google-modules/soc/rdo/drivers/ufs/Kconfig
```kconfig
# SPDX-License-Identifier: GPL-2.0-only

config UFS_DW_GOOGLE
	tristate "Google UFS Driver"
	depends on ARCH_GOOGLE
	depends on SCSI_UFSHCD_PLATFORM
	help
	  This adds Google UFS variant driver based on DWC
	  required for UFS in RDO
	  Select "Y" if you have such device.
	  If unsure select "N".

config UFS_PIXEL_FEATURES
	bool "Enable Pixel specific features"
	help
	  This option enables Pixel specific features in addition to the
	  platform driver.

config UFS_PIXEL_CRYPTO
	bool "Enable Pixel UFS encryption"
	depends on SCSI_UFS_CRYPTO
	help
	  This option enables Pixel support for Android encryption services.
```

## private/google-modules/soc/rdo/pci/Kconfig
```kconfig
# SPDX-License-Identifier: GPL-2.0-only

config PCIE_DW_GOOGLE
	tristate "Google PCIe root complex driver support"
	depends on ARCH_GOOGLE
	depends on PCI
	depends on GOOGLE_CPM_CLK
	depends on GOOGLE_IRM
	select PCIE_DW_HOST
	help
	  Enable support for the PCIe controller
	  root complex driver.
	  Select Y if you have such device.
	  If unsure select "N".
```
