## private/devices/google/lga/Kconfig.ext.lga
```kconfig
# SPDX-License-Identifier: GPL-2.0-only

source "$(KCONFIG_SOC_RDO_PREFIX)Kconfig"

source "$(KCONFIG_SOC_GS_PREFIX)drivers/dma-buf/heaps/samsung/Kconfig"

source "$(KCONFIG_SOC_GS_PREFIX)drivers/iommu/Kconfig"

source "$(KCONFIG_SOC_GS_PREFIX)drivers/soc/google/gsa/Kconfig"

source "$(KCONFIG_SOC_GS_PREFIX)drivers/soc/google/pt/Kconfig"

source "$(KCONFIG_SOC_GS_PREFIX)drivers/soc/google/vh/kernel/Kconfig"

source "$(KCONFIG_SOC_GS_PREFIX)drivers/mfd/Kconfig"

source "$(KCONFIG_SOC_GS_PREFIX)drivers/misc/sbb-mux/Kconfig"

source "$(KCONFIG_SOC_GS_PREFIX)drivers/pinctrl/Kconfig"

source "$(KCONFIG_SOC_GS_PREFIX)drivers/power/reset/Kconfig"

source "$(KCONFIG_SOC_GS_PREFIX)drivers/regulator/Kconfig"

source "$(KCONFIG_SOC_GS_PREFIX)drivers/spmi/Kconfig"

source "$(KCONFIG_SOC_GS_PREFIX)drivers/misc/s5910/Kconfig"

source "$(KCONFIG_SOC_GS_PREFIX)drivers/misc/sscoredump/Kconfig"

source "$(KCONFIG_SOC_GS_PREFIX)drivers/usb/dwc3/Kconfig"

source "$(KCONFIG_SOC_GS_PREFIX)drivers/usb/gadget/Kconfig"

source "$(KCONFIG_SOC_GS_PREFIX)drivers/usb/typec/tcpm/google/Kconfig"

source "$(KCONFIG_SOC_GS_PREFIX)drivers/soc/google/Kconfig"

source "$(KCONFIG_SOC_GS_PREFIX)drivers/input/Kconfig"

source "$(KCONFIG_EXT_MODULES_PREFIX)private/google-modules/aoc/Kconfig"

source "$(KCONFIG_EXT_MODULES_PREFIX)private/google-modules/aoc/alsa/Kconfig"

source "$(KCONFIG_EXT_MODULES_PREFIX)private/google-modules/aoc/usb/Kconfig"

source "$(KCONFIG_EXT_MODULES_PREFIX)private/google-modules/bms/misc/Kconfig"

source "$(KCONFIG_EXT_MODULES_PREFIX)private/google-modules/display/common/Kconfig"

source "$(KCONFIG_EXT_MODULES_PREFIX)private/google-modules/display/vsi-drm/bridge/synopsys/dsi2host/Kconfig"

source "$(KCONFIG_EXT_MODULES_PREFIX)private/google-modules/display/vsi-drm/phy/synopsys/Kconfig"

source "$(KCONFIG_EXT_MODULES_PREFIX)private/google-modules/display/vsi-drm/verisilicon/Kconfig"

source "$(KCONFIG_EXT_MODULES_PREFIX)private/google-modules/display/vsi-drm/dwc_dptx/Kconfig"

source "$(KCONFIG_EXT_MODULES_PREFIX)private/google-modules/display/vsi-g2d/google/Kconfig"

source "$(KCONFIG_EXT_MODULES_PREFIX)private/google-modules/iommu/arm-smmu-v3/drivers/iommu/Kconfig"

source "$(KCONFIG_EXT_MODULES_PREFIX)private/google-modules/lwis/Kconfig"

source "$(KCONFIG_EXT_MODULES_PREFIX)private/google-modules/perf/Kconfig"

source "$(KCONFIG_EXT_MODULES_PREFIX)private/google-modules/power/reset/Kconfig"

source "$(KCONFIG_EXT_MODULES_PREFIX)private/google-modules/powervr/Kconfig"

source "$(KCONFIG_EXT_MODULES_PREFIX)private/google-modules/radio/common/metrics_collection/Kconfig"

source "$(KCONFIG_EXT_MODULES_PREFIX)private/google-modules/touch/common/Kconfig"

source "$(KCONFIG_EXT_MODULES_PREFIX)private/google-modules/trusty/drivers/trusty/Kconfig"

source "$(KCONFIG_EXT_MODULES_PREFIX)private/google-modules/video/cnm/Kconfig"
```

## private/google-modules/aoc/Documentation/devicetree/bindings/google,aoc.yaml
```yaml
# SPDX-License-Identifier: GPL-2.0-only OR BSD-2-Clause
%YAML 1.2
---
$id: http://devicetree.org/schemas/reserved-memory/google,open-dice.yaml#
$schema: http://devicetree.org/meta-schemas/core.yaml#

title: AoC SoC

description: |
  This binding represents the AoC component.

maintainers:
  - Alex Iacobucci <alexiacobucci@google.com>

properties:
  compatible:
    const: google,aoc

  wifi-chip:
    description:
      integer specifying the wifi chip for that particulare device.
    maxItems: 1

  gdmc-iface:
    description:
      Reference to the GDMC node, if any.
    maxItems: 1

  power-domains:
    description:
      Power domains relevant for AoC.

  power-domain-names:
    description:
      Names for each of the power domains listed in property `power-domains`.

  gsa-enabled:
    description:
      Boolean specifying whether GSA boot for AOC is enabled. Must be unset if false.
    maxItems: 1

required:
  - compatible
  - power-domains
  - power-domain-names

# TODO: add remaining items in required and properties.

examples:
  - |
    {
      aoc: aoc@9000000 {
        compatible = "google,aoc";
        reg = <0x0 0x09000000 0x0 0x02000000>,
          <0x0 0xB4C0000 0x0 0x000be28>;
        reg-names = "blk_aoc", "lcpm";
        iommus = <&cpuacc_mmu 0x8300>;

        memory-region = <&aoc_reserve>;

        mboxes = <
          &aoc_ap_0_mba_client_0 0
          &aoc_ap_1_mba_client_1 0
          &aoc_ap_2_mba_client_2 0
          &aoc_ap_3_mba_client_3 0
          &aoc_ap_4_mba_client_4 0
          &aoc_ap_5_mba_client_5 0
          &aoc_ap_6_mba_client_6 0
          &aoc_ap_7_mba_client_7 0
          &aoc_ap_8_mba_client_8 0
          &aoc_ap_9_mba_client_9 0
          &aoc_ap_10_mba_client_10 0
          &aoc_ap_11_mba_client_11 0
          &aoc_ap_12_mba_client_12 0
          &aoc_ap_13_mba_client_13 0
          &aoc_ap_14_mba_client_14 0
          &aoc_ap_15_mba_client_15 0
          &aoc_ap_16_mba_client_16 0
          &aoc_ap_17_mba_client_17 0
          &aoc_ap_18_mba_client_18 0
          &aoc_ap_19_mba_client_19 0
        >;

        power-domains = <&sswrp_aoc_pd>, <&aoc_core_pd>;
        power-domain-names = "sswrp_aoc_pd", "aoc_core_pd";

        pinctrl-names = "default", "idle";
        pinctrl-0 = <&aoc_uart0_rxd_rtsn_pins>, <&aoc_uart0_txd_ctsn_pins>,
          <&aoc_uart1_rxd_rtsn_pins>, <&aoc_uart1_txd_ctsn_pins>,
          <&aoc_uart2_pins>, <&aoc_i2c2_pins>, <&aoc_i2c4_pins>,
          <&aoc_i3c0_pins>, <&aoc_i3c1_pins>, <&aoc_tdm1_in_pins>,
          <&aoc_tdm1_out_pins>, <&aoc_pdm_pins>, <&aoc_pdm1_pins>,
          <&aoc_pdm2_pins>, <&aoc_pdm3_pins>, <&aoc_tdm0_in_pins>,
          <&aoc_tdm0_out_pins>, <&aoc_i2s0_in_pins>, <&aoc_i2s0_out_pins>,
          <&aoc_i2s1_in_pins>, <&aoc_i2s1_out_pins>, <&aoc_modem_out_pins>,
          <&aoc_modem_in_pins>, <&aoc_modem_pcm_valid_pins>;
        pinctrl-1 = <>;

        mbox-channels = <20>;

        clock-divider = <1>;

        channel-max-pending-msgs = <128>;
        block-channel-threshold = <64>;

        notify-on-state-transition = "true";
        hotword-supported = "true";
        chre-supported = "true";
        iommu-config-persistent = "true";

        aoc-coredump-mbox = <19>;

        gdmc-iface = <&goog_mba_gdmc_iface>;

        gsa-device = <&gsa>;
        gsa-enabled = "true";
      };
    };
```

## private/google-modules/aoc/alsa/Kconfig
```kconfig
# SPDX-License-Identifier: GPL-2.0-only
#
# AoC ALSA configuration
#

config AOC_ALSA_USB
	bool "AoC ALSA USB audio support"
	depends on AOC_DRIVER
	help
		Say yes here to support USB audio

config AOC_ALSA_DP_AUDIO
	bool "AoC ALSA DP audio support"
	depends on AOC_DRIVER
	default y if DRM_SAMSUNG_DP_AUDIO
	default y if DWC_DPTX_AUDIO
	help
		Say yes here to support DP Audio

config AOC_ALSA_INCALL_CAP_3
	bool "AoC ALSA incall capture stream 3"
	depends on AOC_DRIVER
	default n
	help
		Say yes here to support incall capture stream 3
```

## private/google-modules/display/vsi-drm/verisilicon/Kconfig
```kconfig
# SPDX-License-Identifier: GPL-2.0

config DRM_VERISILICON
	tristate "DRM Support for VeriSilicon"
	depends on DRM
	select DRM_KMS_HELPER
	help
	  Choose this option if you have a VeriSilicon soc chipset.
	  This driver provides VeriSilicon kernel mode
	  setting and buffer management. It does not
	  provide 2D or 3D acceleration.

if DRM_VERISILICON
config VERISILICON_CHIP_9x00
	bool "VeriSilicon display controller of 9x00"
	depends on DRM_VERISILICON
	default y
	help
	  Choose this option if you have a VeriSilicon display controller of
	  9x00 series, otherwise, say N.

config VERISILICON_DC9400_0x316
	bool "VeriSilicon Chip Id 0x316"
	depends on VERISILICON_CHIP_9x00
	default y
	help
	  Choose this option if you want to get VeriSilicon display info of
	  9400_0x316.

config VERISILICON_DC9400_0x32a
	bool "VeriSilicon Chip Id 0x32a"
	depends on VERISILICON_CHIP_9x00
	help
	  Choose this option if you want to get VeriSilicon display info of
	  9400_0x32a.

config VERISILICON_PLANE_RCD
	bool "Adds support for VeriSilicon plane based RCD"
	depends on VERISILICON_CHIP_9x00
	default y
	help
	  Choose this option to enable plane based rounded corner implementation
	  for devices that support it.

config VERISILICON_MIPI_DSI2H
	bool "Integration with Synopsis MIPI DSI2 Host driver"
	select DRM_DW_MIPI_DSI2H
	help
	  Choose this option to add support for MIPI DSI using Verisilicon
	  display controller along with Synopsis MIPI DSI2 Host.

config VERISILICON_REGMAP
	bool "Adds support for VeriSilicon REGMAP"
	depends on CONFIG_REGMAP
	help
	  Choose this option to add support bulk register read/write using
	  VeriSilicon REGMAP for 9x00 series, otherwise, say N.

config VERISILICON_DISPLAYPORT
	bool "Enables DisplayPort encoder driver"
	default y if DWC_DPTX
	help
	  Enable this option to include the DisplayPort encoder driver,
	  which allows connecting a DisplayPort encoder to the
	  DPTX driver,
	  otherwise, say N.
endif
```

## private/google-modules/display/vsi-g2d/google/Kconfig
```kconfig
# SPDX-License-Identifier: MIT

config DRM_G2D
	tristate "VSI G2D support using DRM/KMS"
	depends on DRM
	select DRM_KMS_HELPER
	help
	  Choose this option if you have a VeriSilicon G2D block
	  and want to use the DRM KMS driver for it developed by Google.
```

## private/google-modules/perf/Kconfig
```kconfig
# SPDX-License-Identifier: GPL-2.0-only

source "$(KCONFIG_EXT_MODULES_PREFIX)private/google-modules/perf/core/Kconfig"

source "$(KCONFIG_EXT_MODULES_PREFIX)private/google-modules/perf/thermal/Kconfig"

source "$(KCONFIG_EXT_MODULES_PREFIX)private/google-modules/perf/memory/Kconfig"
```

## private/google-modules/perf/core/Kconfig
```kconfig
# SPDX-License-Identifier: GPL-2.0-only
#
# core modules configuration
#

source "$(KCONFIG_EXT_MODULES_PREFIX)private/google-modules/perf/core/gs_perf_mon/Kconfig"
source "$(KCONFIG_EXT_MODULES_PREFIX)private/google-modules/perf/core/gs_domain_idle/Kconfig"
source "$(KCONFIG_EXT_MODULES_PREFIX)private/google-modules/perf/core/irm_devfreq/Kconfig"
source "$(KCONFIG_EXT_MODULES_PREFIX)private/google-modules/perf/core/lat_govs/Kconfig"

config GOOGLE_PM_QOS
	tristate "Google PM QOS"
	help
	  Enable support for Google PM QOS module
	  The driver provides interfaces to monitor which driver
	  is registering frequency votes against pm_qos domains.

config GOOGLE_VOTE_MANAGER
	tristate "Google Vote Manager"
	help
	  Enable support for Google Vote Manager module
	  The module expose sysf nodes for userland cpu/device
	  frequency voting
```

## private/google-modules/perf/core/lat_govs/Kconfig
```kconfig
# SPDX-License-Identifier: GPL-2.0-only
#
# Configurations for Tick Driven Memory
# Latency Governors.
#

config GS_MEMLAT_GOVERNOR
	tristate "Google MEMSS/GMC Latency Governor"
	depends on GS_PERF_MON
	depends on GOOGLE_PM_QOS
	default n
	help
	  The Google memlat governors provides DVFS frequency votes for the
	  memory fabric subsystem. The governors only compute target frequencies
	  for the MEMSS, and GMCs then submits the votes via the Google PM QOS
	  system for vote processing.

config GS_DSULAT_GOVERNOR
        tristate "Google DSU Latency Governor"
        depends on GS_PERF_MON
        depends on GOOGLE_PM_QOS
        default n
        help
          The Google dsulat governors provides DVFS frequency votes for the
          DSU cache. The governors only compute target frequencies for the DSU,
          then submits the votes via the Google PM QOS system for vote processing.
```

## private/google-modules/perf/thermal/Kconfig
```kconfig
# SPDX-License-Identifier: GPL-2.0-only
#
# thermal modules configuration

config GOOGLE_THERMAL_SENSOR
	tristate "Google LLC thermal sensor driver"
	depends on THERMAL && GOOGLE_THERMAL && PIXEL_METRICS
	help
	  This driver configures and enables the NTC thermistors. The
	  configuration includes enabling the NTC channel, configuring the
	  polling rate and setting the thresholds for software monitoring
	  and hardware protection.

config GOOGLE_THERMAL_CPM_MBOX
	tristate "Google LLC thermal cpm mailbox driver"
	help
	  This driver provide mailbox interface for different thermal
	  functionalities. It provide send message and send request to
	  CPM, and it also provide RX callback when CPM send a message
	  to thermal service.

config GOOGLE_POWERCAP
	tristate "Google LLc powercap framework"
	depends on POWERCAP && OF && VH_SCHED && PIXEL_EM
	help
	  This driver provides the infrastructure for building the powertree
	  for pixel devices. The tree nodes can be real power consuming devices
	  like CPU, GPU, etc. and virtual nodes, which will manage the power
	  between the child nodes. Enable this framework for thermal monitoring
	  in userspace to provide a power budget for the powertree to control
	  thermal.

config GOOGLE_THERMAL_UCLAMP
	tristate "Google LLC thermal sensor driver"
	depends on THERMAL && VH_SCHED && PIXEL_EM && OF
	help
	  This module will register cooling device to place thermal auto uclamp max
	  for each cluster. There will be one cooling device per cluster and thermal
	  governors can use these cooling device to mitigate CPU to selectively allow
	  ADPF tasks to use the max CPU capacity.

config GOOGLE_THERMAL_SENSOR_STATS
	tristate "Google LLC thermal sensor stats driver"
	depends on GOOGLE_THERMAL_CPM_MBOX && PIXEL_METRICS
	help
	  This driver registers CPM HW thermal zone to the Pixel metrics
	  framework. It also provides callback functions to access CPM shared
	  memory for data and configuration of thermal stats, including
	  temperature residency and daily max/min temperature.
```

## private/google-modules/powervr/pvrsrvkm/Kconfig
```kconfig
config POWERVR_ROGUE
	tristate "PowerVR GPU"
	default n
	depends on DRM
	help
	  Driver for PowerVR graphics processor hardware.

	  Say Y here if your SoC contains a PowerVR GPU. For more
	  information, see <http://www.imgtec.com/powervr/>.

config POWERVR_ROGUE_PDUMP
	bool "Parameter dumping"
	default n
	depends on POWERVR_ROGUE

config POWERVR_ROGUE_RESOURCE_INFO
	bool "Resource info"
	default n
	depends on POWERVR_ROGUE
	help
	  Annotate device memory allocations with human-readable names.
	  Requires a compatible userspace driver.

config POWERVR_ROGUE_DEBUG
	bool "Turn on DDK debug build"
	default n
	depends on POWERVR_ROGUE
```

## private/google-modules/soc/gs/drivers/block/zram/defconfig
```kconfig
CONFIG_ZRAM_GS=m
CONFIG_ZCOMP_CPU=m
CONFIG_ZCOMP_EH=m
CONFIG_ZRAM_GS_WRITEBACK=y
CONFIG_ZRAM_GS_VENDOR_HOOK=y
```

## private/google-modules/soc/gs/drivers/usb/dwc3/Kconfig
```kconfig
# SPDX-License-Identifier: GPL-2.0

if USB_DWC3

config USB_DWC3_EXYNOS_GS
	tristate "GS Platform"
	depends on (USB_DWC3 || COMPILE_TEST) && OF
	help
	  'USB_DWC3_EXYNOS_GS' is glue layer which can be used with
	  Synopsys DWC3 controller on GS SoCs. Say 'Y' or 'M'
	  if you have one such devices.

endif

config GOOGLE_USB_ROLE_SW
	tristate "USB data role switch for Google devices"
	depends on EXTCON
	select GOOGLE_VOTABLE
	help
	  'GOOGLE_USB_ROLE_SW' is a virtual device for collecting any
	  Google specific USB data role switch limitations. The virtual
	  device will aggregate usb data role switch requests from
	  different drivers and elect a vaild one, then pass it to down-
	  stream device. Say 'Y' or 'M' if you need this device.
```

## private/google-modules/soc/gs/drivers/usb/host/Kconfig
```kconfig
# SPDX-License-Identifier: GPL-2.0
#
# USB Host Controller Drivers
#

if USB_XHCI_HCD

config USB_XHCI_EXYNOS
	tristate "xHCI support for EXYNOS SoCs"
	help
	  Say 'Y' to enable the support for the xHCI host controller
	  found in Exynos SoCs.

config USB_XHCI_GOOG_DMA
	tristate "xHCI DMA driver for GOOG SoCs"
	help
	  Say 'Y' to enable the support for the xHCI DMA driver for
	  GOOG SoCs.

config USB_VENDOR_HOOKS
	bool "Enable USB vendor hooks"
	depends on USB_XHCI_EXYNOS
	default n
	help
	  This config is used to enable/disable the USB vendor hooks.

endif # USB_XHCI_HCD
```
