## private/google-modules/soc/rdo/power-controller/Kconfig
```kconfig
# SPDX-License-Identifier: GPL-2.0-only

config GOOGLE_POWER_CONTROLLER
	tristate "Google power controller driver"
	depends on GOOGLE_MBA_CPM_INTERFACE
	select PM_GENERIC_DOMAINS
	help
	  This driver allows client to power on/off Google SoC
	  power domains via generic power domain framework.
	  For GPU, it directly update LPCM registers. For other
	  sswrps, it sends a MBA mailbox to CPM to request toggle
	  the power domains.

config GOOGLE_POWER_CONTROLLER_GPU_MITIGATION
       tristate "Google power controller driver with the GPU MITIGATION feature"
       depends on GOOGLE_POWER_CONTROLLER
       help
         This driver is to configures the GPU mitigation response
         settings.
```

## private/google-modules/soc/rdo/usb/Kconfig
```kconfig
# SPDX-License-Identifier: GPL-2.0-only

config USB_DWC3_GOOGLE
	tristate "Google DWC3 USB"
	depends on ARCH_GOOGLE
	depends on USB_DWC3 && GOOGLE_IRM
	help
	  Google's Glue driver for the Synopsys DWC3 USB controller.
	  If unsure select "N".

config USB_XHCI_GOOG_DMA
	tristate "xHCI DMA driver for Google SoCs"
	depends on ARCH_GOOGLE
	help
	  Say 'Y' to enable the support for the xHCI DMA driver for
	  Google SoCs.
```

## private/google-modules/video/cnm/Kconfig
```kconfig
# SPDX-License-Identifier: GPL-2.0-only
#
# Codec3P configuration
#
comment "Codec3P video codec"

config CODEC3P
	tristate "Codec3P video codec"
	default n
	help
	Driver for Codec3P video codec

config CODEC3P_SLC
	bool "Codec3P SLC support"
	default y
	depends on GOOGLE_RA
	depends on SLC_PARTITION_MANAGER
	help
	  Enable SLC for Codec3P. This config
	  require GOOGLE_RA and SLC_PARTITION_MANAGER.
	  Select Y if you have such device.
	  If unsure select "N".
```
